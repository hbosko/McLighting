#include <Arduino.h>
#include "StreamString.h"
#include "ESPAsyncHTTPUpdateServer.h"
#include <Ticker.h>

#ifdef ESP32
    #include <LittleFS.h>
    #include <Update.h>
#elif defined(ESP8266)
    #include <flash_hal.h>
    #include <FS.h>
#else
  #error "This library only supports boards with an ESP8266 or ESP32 processor."
#endif

#ifndef ESPASYNCHTTPUPDATESERVER_SerialOutput
    #define ESPASYNCHTTPUPDATESERVER_SerialOutput Serial
#endif

#ifdef ESPASYNCHTTPUPDATESERVER_DEBUG
    #define Log(...) ESPASYNCHTTPUPDATESERVER_SerialOutput.printf(__VA_ARGS__)
#else
    #define Log(...) 
#endif

const uint8_t serverIndex[] PROGMEM = {
0x1F, 0x8B, 0x08, 0x08, 0x5A, 0xA8, 0xEB, 0x6A, 0x04, 0x00, 0x66, 0x77, 0x2E, 0x68, 0x74, 0x6D, 
0x6C, 0x00, 0xAD, 0x58, 0xD9, 0xAE, 0xD3, 0x30, 0x10, 0x7D, 0x47, 0xE2, 0x1F, 0x4C, 0x10, 0x90, 
0x42, 0x13, 0x7A, 0xCB, 0x9E, 0xDE, 0x16, 0xB1, 0x2F, 0x62, 0x13, 0xBB, 0x84, 0x78, 0x70, 0x92, 
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0x6F, 0x09, 0x52, 0xD6, 0xA9, 0x4E, 0x1E, 0x00, 0x00
};

static const char successResponse[] PROGMEM = R"(<meta content="15;URL=/"http-equiv=refresh>Update Success! Rebooting...)";

//with iframe!
//static const char successResponse[] PROGMEM = R"(Update Success! Rebooting... <script>setTimeout(function(){ window.top.location.href = '/'; }, 15000);</script>)";

Ticker restartTimer;

ESPAsyncHTTPUpdateServer::ESPAsyncHTTPUpdateServer()
{
    _server = NULL;
    _username = emptyString;
    _password = emptyString;
    _authenticated = false;
}

void ESPAsyncHTTPUpdateServer::setup(AsyncWebServer *server, const String &path, const String &username, const String &password)
{
    _server = server;
    _username = username;
    _password = password;

    // handler for the /update form page
    _server->on(path.c_str(), HTTP_GET, [&](AsyncWebServerRequest *request)
                {
            if(_username != emptyString && _password != emptyString)
                if( !request->authenticate(_username.c_str(), _password.c_str()))
                    return request->requestAuthentication();
#ifdef ESP32
            AsyncWebServerResponse* response = request->beginResponse_P(200, "text/html", serverIndex, sizeof(serverIndex));
#else
            AsyncWebServerResponse* response = request->beginResponse_P(200, "text/html", serverIndex, sizeof(serverIndex));
#endif
            response->addHeader("Content-Encoding", "gzip");
            request->send(response); });

    // handler for the /update form page - preflight options
    _server->on(path.c_str(), HTTP_OPTIONS, [&](AsyncWebServerRequest *request)
                {
            AsyncWebServerResponse* response = request->beginResponse(200,F("text/html"), String(F("y")));
            response->addHeader("Access-Control-Allow-Headers", "*");
            response->addHeader("Access-Control-Allow-Origin", "*");
            request->send(response); 
            
            _authenticated = (_username == emptyString || _password == emptyString || request -> authenticate(_username.c_str(), _password.c_str()));
            if (!_authenticated)
            {
                Log("Unauthenticated Update\n");
                return;
            } });

    // handler for the /update form POST (once file upload finishes)
    _server->on(
        path.c_str(), HTTP_POST, [&](AsyncWebServerRequest *request)
        {
        // if requestAuthentication() is false second handler will run, else it wont.
        if (!_authenticated)
            return request->requestAuthentication();

        if (_updateResult != UpdateResult::UPDATE_OK)
        {
            AsyncWebServerResponse *response = request->beginResponse(200, F("text/html"), Update.hasError() ? String(F("Update error: ")) + _updaterError : "Update aborted by server.");
            response->addHeader("Access-Control-Allow-Headers", "*");
            response->addHeader("Access-Control-Allow-Origin", "*");
            response->addHeader("Connection", "close");
            request->send(response);
        }
        else
        {
#ifdef ESP32
            request->send(200, PSTR("text/html"), successResponse);
#else
            request->send_P(200, PSTR("text/html"), successResponse);
#endif
            Log("Rebooting...\n");
            restartTimer.once_ms(1000,[]{ ESP.restart(); });
        } },
        [&](AsyncWebServerRequest *request, String filename, size_t index, uint8_t *data, size_t len, bool final)
        {
            // handler for the file upload, gets the sketch bytes, and writes
            // them through the Update object

            _updateType = request->getParam("name")->value() == "filesystem"?
                    UpdateType::FILE_SYSTEM :
                    UpdateType::FIRMWARE;

            if (!index)
            {
                _updaterError.clear();

#ifdef ESPASYNCHTTPUPDATESERVER_DEBUG
                ESPASYNCHTTPUPDATESERVER_SerialOutput.setDebugOutput(true);
#endif
                _authenticated = (_username == emptyString || _password == emptyString || request->authenticate(_username.c_str(), _password.c_str()));
                if (!_authenticated)
                {
                    Log("Unauthenticated Update\n");
                    return;
                }

                if (onUpdateBegin)
                {
                    _updateResult = UpdateResult::UPDATE_OK;
                    onUpdateBegin(_updateType, _updateResult);
                    if (_updateResult != UpdateResult::UPDATE_OK)
                    {
                        Log("Update aborted by server: %d\n", _updateResult);
                        if(onUpdateEnd)
                            onUpdateEnd(_updateType, _updateResult);
                        return;
                    }
                }

                Log("Update: %s\n", filename.c_str());
#ifdef ESP8266
                Update.runAsync(true);
#endif
                if (_updateType == UpdateType::FILE_SYSTEM)
                {
                    Log("updating filesystem\n");
#ifdef ESP8266
                    int command = U_FS;
                    size_t fsSize = ((size_t)FS_end - (size_t)FS_start);
                    close_all_fs();
#elif defined(ESP32)
                    int command = U_SPIFFS;
                    size_t fsSize = LittleFS.totalBytes();
#endif
                    if (!Update.begin(fsSize, command))
                    { // start with max available size
#ifdef ESPASYNCHTTPUPDATESERVER_DEBUG
                        Update.printError(ESPASYNCHTTPUPDATESERVER_SerialOutput);
#endif
                    }
                }
                else
                {
                    Log("updating flash\n");
                    uint32_t maxSketchSpace = (ESP.getFreeSketchSpace() - 0x1000) & 0xFFFFF000;
                    if (!Update.begin(maxSketchSpace, U_FLASH)) // start with max available size
                        _setUpdaterError();
                }
            }

            if (_authenticated && len && _updateResult == UpdateResult::UPDATE_OK)
            {
                Log(".");
                if (Update.write(data, len) != len)
                    _setUpdaterError();
            }

            if (_authenticated && final && _updateResult == UpdateResult::UPDATE_OK)
            {
                if (Update.end(true))
                { // true to set the size to the current progress
                    Log("Update Success.\n");
                    _updateResult = UpdateResult::UPDATE_OK;
                    if(onUpdateEnd)
                        onUpdateEnd(_updateType, _updateResult);
                }
                else
                    _setUpdaterError();
#ifdef ESPASYNCHTTPUPDATESERVER_DEBUG
                ESPASYNCHTTPUPDATESERVER_SerialOutput.setDebugOutput(false);
#endif
            }
            else
                return;
        });
}

void ESPAsyncHTTPUpdateServer::_setUpdaterError()
{
#ifdef ESPASYNCHTTPUPDATESERVER_DEBUG
    Update.printError(ESPASYNCHTTPUPDATESERVER_SerialOutput);
#endif
    StreamString str;
    Update.printError(str);
    _updaterError = str.c_str();
    
    _updateResult = UpdateResult::UPDATE_ERROR;
    if(onUpdateEnd)
        onUpdateEnd(_updateType, _updateResult);
}